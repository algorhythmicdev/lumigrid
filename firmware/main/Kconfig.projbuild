## firmware/main/Kconfig.projbuild
```kconfig
menu "LumiGrid Firmware Options"
    config LUMIGRID_ENABLE_INTERNAL_TESTS
        bool "Enable LumiGrid internal unit tests"
        default n
        help
            Compile in Unity-based internal tests for LumiGrid firmware modules.
            Enable when running `idf.py test` to exercise drivers without hardware.
endmenu
```

## firmware/sdkconfig.defaults
```kconfig
# ESP32 optimization
CONFIG_COMPILER_OPTIMIZATION_SIZE=y
CONFIG_COMPILER_OPTIMIZATION_ASSERTIONS_SILENT=y

# FreeRTOS
CONFIG_FREERTOS_HZ=1000

# LittleFS
CONFIG_LITTLEFS_MAX_PARTITIONS=3

# ESP HTTP Server
CONFIG_HTTPD_MAX_REQ_HDR_LEN=1024
CONFIG_HTTPD_MAX_URI_LEN=512

# Wi-Fi
CONFIG_ESP32_WIFI_STATIC_RX_BUFFER_NUM=10
CONFIG_ESP32_WIFI_DYNAMIC_RX_BUFFER_NUM=32
CONFIG_ESP32_WIFI_DYNAMIC_TX_BUFFER_NUM=32

# MQTT
CONFIG_MQTT_PROTOCOL_311=y

# Watchdog
CONFIG_ESP_TASK_WDT=y
CONFIG_ESP_TASK_WDT_TIMEOUT_S=10
```

## sdkconfig.defaults
```kconfig
CONFIG_ESPTOOLPY_FLASHSIZE_4MB=y
CONFIG_PARTITION_TABLE_CUSTOM=y
CONFIG_PARTITION_TABLE_CUSTOM_FILENAME="partitions.csv"
CONFIG_ESP_WIFI_SSID_SET_FROM_MENUCONFIG=y
CONFIG_ESP_WIFI_PASSWORD_SET_FROM_MENUCONFIG=y
CONFIG_ESP_WIFI_SSID="LumiGridSetup"
CONFIG_ESP_WIFI_PASSWORD="lumigrid123"
CONFIG_LUMIGRID_UDP_PORT=4210
CONFIG_LUMIGRID_LED_COUNT=300
CONFIG_LUMIGRID_LED_TYPE_WS2812=y
CONFIG_LUMIGRID_LED_PIN=13
CONFIG_LUMIGRID_FPS_LIMIT=60
```
